## esp01/main/Kconfig.projbuild
```kconfig
menu "Configuração do Wifi"

    config ESP_WIFI_SSID
        string "WiFi SSID"
        default "ssid"
        help
            Nome da rede Wifi.

    config ESP_WIFI_PASSWORD
        string "Senha do Wifi"
        default "minha_senha"
        help
            Senha do WiFi (WPA or WPA2).

    config ESP_MAXIMUM_RETRY
        int "Número máximo de tentativas de conexão"
        default 5
        help
            Configure o valor máximo de tentativas de conexão.
endmenu

menu "MQTT Configuration"

	config MQTT_SERVER_URI
		string "URI"
		default "mqtt://164.41.98.25"
		help
			MQTT Server URI.

	config MQTT_USERNAME
		string "Username"
		default "oFAplGpnm29CsCAGd0Al"
		help
			MQTT Username or token.
endmenu
```
